## tests/persist_state/testcase.yaml
```yaml
tests:
  zephyr_secure_supervisor.persist_state:
    platform_allow:
      - native_sim
    tags:
      - persist_state
```

## tests/supervisor/testcase.yaml
```yaml
tests:
  zephyr_secure_supervisor.supervisor:
    platform_allow:
      - native_sim
    tags:
      - supervisor
```

## tests/unit/misra_stage1/testcase.yaml
```yaml
tests:
  zephyr_secure_supervisor.misra_stage1:
    platform_allow:
      - nucleo_l053r8
    build_only: true
```
