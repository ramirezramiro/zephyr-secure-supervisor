## CMakeLists.txt
```
cmake_minimum_required(VERSION 3.20.0)
set(APP_ROOT ${CMAKE_CURRENT_SOURCE_DIR}/../..)
set(KCONFIG_ROOT ${APP_ROOT}/Kconfig)
set(BOARD_ROOT ${APP_ROOT})

set(DTC_OVERLAY_FILE ${APP_ROOT}/tests/common/native.overlay)

find_package(Zephyr REQUIRED HINTS $ENV{ZEPHYR_BASE})
project(persist_state_tests)

target_sources(app PRIVATE
  ${APP_ROOT}/src/app_crypto.c
  ${APP_ROOT}/src/curve25519_ref10.c
  ${APP_ROOT}/src/simple_aes.c
  ${APP_ROOT}/src/persist_state.c
  src/main.c
)

target_include_directories(app PRIVATE ${APP_ROOT}/src)
```

## prj.conf
```kconfig
CONFIG_ZTEST=y
CONFIG_LOG=y
CONFIG_THREAD_NAME=y

# Match application crypto behavior
CONFIG_APP_USE_AES_ENCRYPTION=y

# Dependencies used by persist_state.c
CONFIG_FLASH=y
CONFIG_FLASH_MAP=y
CONFIG_FLASH_PAGE_LAYOUT=y
CONFIG_NVS=y

# Keep stacks modest for native_sim
CONFIG_MAIN_STACK_SIZE=2048
CONFIG_HEAP_MEM_POOL_SIZE=2048
```

## prj_curve.conf
```kconfig
# Curve25519 test overlay for persist_state
CONFIG_APP_CRYPTO_BACKEND_CURVE25519=y
CONFIG_APP_USE_CURVE25519=y
CONFIG_APP_USE_AES_ENCRYPTION=y
CONFIG_APP_CURVE25519_STATIC_SECRET_HEX="77076D0A7318A57D3C16C17251B26645DF4C2F87EBC0992AB177FBA51DB92C2A"
CONFIG_APP_CURVE25519_STATIC_PEER_PUB_HEX="DE9EDB7D7B7DC1B4D35B61C2ECE435373F8343C85B78674DADFC7E146F882B4F"
```

## src/main.c
```c
#include <string.h>

#include <zephyr/ztest.h>

#include "app_crypto.h"
#include "persist_state_priv.h"
#include "persist_state_test.h"

static void *persist_state_suite_setup(void)
{
	int rc = app_crypto_init();
	zassert_ok(rc, "AES helper init failed (%d)", rc);
	return NULL;
}

ZTEST(persist_state_suite, test_encrypt_decrypt_round_trip)
{
	struct persist_blob original;
	struct persist_blob decoded;
	struct persist_blob_encrypted storage = {0};
	size_t cipher_len = 0U;

	persist_state_test_init_blob(&original, 3U, 12U, 2500U);

	int rc = persist_state_test_encrypt_blob(&original, &storage, &cipher_len);
	zassert_ok(rc, "encrypt failed (%d)", rc);
	zassert_equal(cipher_len, sizeof(storage.data), "cipher length mismatch");

	rc = persist_state_test_decrypt_blob(&storage, &decoded);
	zassert_ok(rc, "decrypt failed (%d)", rc);
	zassert_equal(decoded.consecutive_watchdog, original.consecutive_watchdog, NULL);
	zassert_equal(decoded.total_watchdog, original.total_watchdog, NULL);
	zassert_equal(decoded.watchdog_override_ms, original.watchdog_override_ms, NULL);
}

ZTEST(persist_state_suite, test_plain_copy_helper)
{
	struct persist_blob baseline;
	struct persist_blob copied;

	persist_state_test_init_blob(&baseline, 9U, 42U, 0U);
	persist_state_test_copy_plain(&copied, &baseline);

	zassert_equal(memcmp(&copied, &baseline, sizeof(baseline)), 0, "blob copy mismatch");
}

ZTEST_SUITE(persist_state_suite, NULL, persist_state_suite_setup, NULL, NULL, NULL);
```
