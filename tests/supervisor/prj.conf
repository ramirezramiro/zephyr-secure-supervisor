## CMakeLists.txt
```
cmake_minimum_required(VERSION 3.20.0)
set(APP_ROOT ${CMAKE_CURRENT_SOURCE_DIR}/../..)
set(KCONFIG_ROOT ${APP_ROOT}/Kconfig)
set(BOARD_ROOT ${APP_ROOT})

find_package(Zephyr REQUIRED HINTS $ENV{ZEPHYR_BASE})
project(supervisor_tests)

target_sources(app PRIVATE
  ${APP_ROOT}/src/supervisor.c
  src/main.c
  src/stubs.c
)

target_include_directories(app PRIVATE ${APP_ROOT}/src)
```

## prj.conf
```kconfig
CONFIG_ZTEST=y
CONFIG_LOG=y
CONFIG_THREAD_NAME=y

CONFIG_MAIN_STACK_SIZE=2048
CONFIG_HEAP_MEM_POOL_SIZE=2048

# Supervisor-specific knobs
CONFIG_APP_SUPERVISOR_THREAD_STACK_SIZE=512
CONFIG_APP_HEALTH_LED_STALE_MS=6500
CONFIG_APP_HEALTH_SYS_STALE_MS=6500
```

## src/main.c
```c
#include <zephyr/ztest.h>

#include "supervisor_test.h"

static void supervisor_fixture_reset(void)
{
	supervisor_test_set_last_seen(0U, 0U);
}

ZTEST(supervisor_suite, test_led_and_hb_fresh)
{
	uint32_t now = 2000U;
	supervisor_test_set_last_seen(now - 100U, now - 150U);

	struct supervisor_health_snapshot snapshot = supervisor_test_sample(true, now);
	zassert_true(snapshot.led_ok, "LED should be considered fresh");
	zassert_true(snapshot.hb_ok, "Heartbeat should be considered fresh");
}

ZTEST(supervisor_suite, test_led_stale_when_monitored)
{
	uint32_t now = 10000U;
	supervisor_test_set_last_seen(0U, now - 100U);

	struct supervisor_health_snapshot snapshot = supervisor_test_sample(true, now);
	zassert_false(snapshot.led_ok, "LED should be stale when monitoring is enabled");
	zassert_true(snapshot.hb_ok, "Heartbeat remains fresh");
}

ZTEST(supervisor_suite, test_led_ignored_when_not_monitored)
{
	uint32_t now = 5000U;
	supervisor_test_set_last_seen(0U, now - 200U);

	struct supervisor_health_snapshot snapshot = supervisor_test_sample(false, now);
	zassert_true(snapshot.led_ok, "LED should be ignored when not monitored");
	zassert_true(snapshot.hb_ok, "Heartbeat still fresh");
}

ZTEST(supervisor_suite, test_heartbeat_stale)
{
	uint32_t now = 9000U;
	supervisor_test_set_last_seen(now - 100U, 0U);

	struct supervisor_health_snapshot snapshot = supervisor_test_sample(true, now);
	zassert_false(snapshot.hb_ok, "Heartbeat should be stale");
	zassert_true(snapshot.led_ok, "LED is still healthy");
}

ZTEST_SUITE(supervisor_suite, NULL, NULL, supervisor_fixture_reset, supervisor_fixture_reset, NULL);
```

## src/stubs.c
```c
#include <zephyr/sys/util.h>

#include "persist_state.h"
#include "recovery.h"
#include "watchdog_ctrl.h"

int watchdog_ctrl_init(uint32_t timeout_ms)
{
	ARG_UNUSED(timeout_ms);
	return 0;
}

int watchdog_ctrl_feed(void)
{
	return 0;
}

void watchdog_ctrl_set_enabled(bool enable)
{
	ARG_UNUSED(enable);
}

bool watchdog_ctrl_is_enabled(void)
{
	return true;
}

int watchdog_ctrl_retune(uint32_t timeout_ms)
{
	ARG_UNUSED(timeout_ms);
	return 0;
}

uint32_t watchdog_ctrl_get_timeout(void)
{
	return 0U;
}

void persist_state_clear_watchdog_counter(void)
{
}

void recovery_request(enum recovery_reason reason)
{
	ARG_UNUSED(reason);
}
```
