## CMakeLists.txt
```
cmake_minimum_required(VERSION 3.20.0)
set(APP_ROOT ${CMAKE_CURRENT_SOURCE_DIR}/../../..)
set(KCONFIG_ROOT ${APP_ROOT}/Kconfig)
set(BOARD_ROOT ${APP_ROOT})
if(BOARD STREQUAL "nucleo_l053r8")
  set(DTC_OVERLAY_FILE
      ${APP_ROOT}/boards/nucleo_l053r8_secure_supervisor.overlay
      ${APP_ROOT}/boards/nucleo_l053r8_secure_supervisor_app.overlay)
endif()
find_package(Zephyr REQUIRED HINTS $ENV{ZEPHYR_BASE})
project(misra_stage1_tests)

target_sources(app PRIVATE
  ${APP_ROOT}/src/app_crypto.c
  ${APP_ROOT}/src/curve25519_ref10.c
  ${APP_ROOT}/src/simple_aes.c
  ${APP_ROOT}/src/persist_state.c
  ${APP_ROOT}/src/recovery.c
  ${APP_ROOT}/src/supervisor.c
  src/main.c
  src/mock_watchdog_ctrl.c
)

target_include_directories(app PRIVATE ${APP_ROOT}/src)
```

## prj.conf
```kconfig
CONFIG_ZTEST=y
CONFIG_APP_USE_AES_ENCRYPTION=y
CONFIG_APP_AES_STATIC_KEY_HEX="000102030405060708090A0B0C0D0E0F101112131415161718191A1B1C1D1E1F"
CONFIG_APP_AES_STATIC_IV_HEX="00112233445566778899AABB"
CONFIG_APP_SENSOR_SAFE_MODE_INTERVAL_MS=1000
CONFIG_APP_SENSOR_SAMPLE_INTERVAL_MS=1000
CONFIG_APP_HEALTH_SYS_STALE_MS=5000
CONFIG_APP_HEALTH_LED_STALE_MS=5000
CONFIG_APP_WATCHDOG_BOOT_TIMEOUT_MS=8000
CONFIG_APP_WATCHDOG_STEADY_TIMEOUT_MS=2000
CONFIG_APP_WATCHDOG_RETUNE_DELAY_MS=500
CONFIG_APP_RESET_WATCHDOG_THRESHOLD=3
CONFIG_MAIN_STACK_SIZE=2048
CONFIG_ISR_STACK_SIZE=768
CONFIG_APP_SUPERVISOR_THREAD_STACK_SIZE=768
CONFIG_APP_RECOVERY_THREAD_STACK_SIZE=384
CONFIG_APP_SAFE_MODE_REBOOT_DELAY_MS=1000

# Storage / hwinfo dependencies required by persist_state.c
CONFIG_FLASH=y
CONFIG_FLASH_PAGE_LAYOUT=y
CONFIG_FLASH_MAP=y
CONFIG_NVS=y
CONFIG_HWINFO=y
CONFIG_HEAP_MEM_POOL_SIZE=1024

CONFIG_LOG=y
CONFIG_EVENTS=y
```

## prj_curve.conf
```kconfig
# Curve25519 overlay for MISRA ztest
CONFIG_APP_CRYPTO_BACKEND_CURVE25519=y
CONFIG_APP_USE_CURVE25519=y
CONFIG_APP_USE_AES_ENCRYPTION=y
CONFIG_APP_CURVE25519_STATIC_SECRET_HEX="77076D0A7318A57D3C16C17251B26645DF4C2F87EBC0992AB177FBA51DB92C2A"
CONFIG_APP_CURVE25519_STATIC_PEER_PUB_HEX="DE9EDB7D7B7DC1B4D35B61C2ECE435373F8343C85B78674DADFC7E146F882B4F"
```

## src/main.c
```c
#include <zephyr/ztest.h>
#include <zephyr/kernel.h>

#include "app_crypto.h"
#include "safe_memory.h"
#include "persist_state_priv.h"
#include "persist_state_test.h"
#include "supervisor_test.h"
#include "recovery_test.h"
#include "recovery.h"

static void *misra_stage1_setup(void)
{
	int rc = app_crypto_init();
	zassert_equal(rc, 0, "app_crypto_init failed (%d)", rc);
#if defined(CONFIG_ZTEST)
	recovery_test_init_event();
#endif
	return NULL;
}

ZTEST_SUITE(misra_stage1, NULL, misra_stage1_setup, NULL, NULL, NULL);

ZTEST(misra_stage1, test_safe_memory_helpers)
{
	uint8_t src[8] = {0, 1, 2, 3, 4, 5, 6, 7};
	uint8_t dst[8] = {0};

	safe_memcpy(dst, sizeof(dst), src, sizeof(src));
	zassert_mem_equal(dst, src, sizeof(src), "memcpy mismatch");

	safe_memset(dst, sizeof(dst), 0xAA, sizeof(dst));
	for (size_t i = 0U; i < ARRAY_SIZE(dst); i++) {
		zassert_equal(dst[i], 0xAA, "memset mismatch at %zu", i);
	}

	const char *msg = "hello";
	size_t len = safe_strlen(msg, 16U);
	zassert_equal(len, 5U, "unexpected strlen result");
}

ZTEST(misra_stage1, test_persist_state_encrypt_decrypt)
{
	struct persist_blob blob;
	struct persist_blob decoded;
	struct persist_blob_encrypted storage;
	size_t cipher_len = 0U;

	persist_state_test_init_blob(&blob, 1U, 10U, 2500U);

	int rc = persist_state_test_encrypt_blob(&blob, &storage, &cipher_len);
	zassert_equal(rc, 0, "encrypt blob failed (%d)", rc);
	zassert_equal(cipher_len, sizeof(blob), "cipher len mismatch");

	rc = persist_state_test_decrypt_blob(&storage, &decoded);
	zassert_equal(rc, 0, "decrypt blob failed (%d)", rc);
	zassert_mem_equal(&decoded, &blob, sizeof(blob), "blob mismatch");
}

ZTEST(misra_stage1, test_persist_state_plain_copy)
{
	struct persist_blob original;
	struct persist_blob copy;

	persist_state_test_init_blob(&original, 2U, 5U, 0U);
	persist_state_test_copy_plain(&copy, &original);

	zassert_mem_equal(&copy, &original, sizeof(original), "plain copy mismatch");
}

ZTEST(misra_stage1, test_supervisor_health_snapshots)
{
	const uint32_t now = 1000U;

	supervisor_test_set_last_seen(now - 100U, now - 200U);
	struct supervisor_health_snapshot healthy =
		supervisor_test_sample(true, now);

	zassert_true(healthy.led_ok, "led should be ok");
	zassert_true(healthy.hb_ok, "hb should be ok");

	supervisor_test_set_last_seen(now - (CONFIG_APP_HEALTH_LED_STALE_MS + 10U),
				      now - (CONFIG_APP_HEALTH_SYS_STALE_MS + 10U));
	struct supervisor_health_snapshot stale =
		supervisor_test_sample(true, now);

	zassert_false(stale.led_ok, "led should be stale");
	zassert_false(stale.hb_ok, "hb should be stale");
}

ZTEST(misra_stage1, test_recovery_event_recording)
{
	recovery_test_clear_pending_events();

	recovery_request(RECOVERY_REASON_MANUAL_TRIGGER);
	uint32_t events = recovery_test_get_pending_events();
	zassert_not_equal(events & BIT(RECOVERY_REASON_MANUAL_TRIGGER), 0U,
			  "manual trigger bit missing");

	recovery_test_clear_pending_events();
	recovery_request(RECOVERY_REASON_HEALTH_FAULT);
	events = recovery_test_get_pending_events();
	zassert_not_equal(events & BIT(RECOVERY_REASON_HEALTH_FAULT), 0U,
			  "health fault bit missing");
}
```

## src/mock_watchdog_ctrl.c
```c
#include <zephyr/sys/util.h>

#include "watchdog_ctrl.h"

int watchdog_ctrl_init(uint32_t timeout_ms)
{
	ARG_UNUSED(timeout_ms);
	return 0;
}

int watchdog_ctrl_feed(void)
{
	return 0;
}

void watchdog_ctrl_set_enabled(bool enable)
{
	ARG_UNUSED(enable);
}

bool watchdog_ctrl_is_enabled(void)
{
	return true;
}

int watchdog_ctrl_retune(uint32_t timeout_ms)
{
	ARG_UNUSED(timeout_ms);
	return 0;
}

uint32_t watchdog_ctrl_get_timeout(void)
{
	return 0U;
}
```
